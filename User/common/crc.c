/******************************************************************************
*  Name: crc.c
*  Description:
*  Project: INFO4 11inch
*  Auther: Fangsong
*  MCU: atmel samda1j16b
*  Comment:
******************************************************************************/
#include "../config.h"
#if (CRC_COM == 1)

#include "crc.h"

/**********************************************************************************************
* External objects
**********************************************************************************************/

/**********************************************************************************************
* Global variables
**********************************************************************************************/

/**********************************************************************************************
* Constants and macros
**********************************************************************************************/

/**********************************************************************************************
* Local types
**********************************************************************************************/

/**********************************************************************************************
* Local function prototypes
*********************************************************************************************/

/**********************************************************************************************
* Local variables
**********************************************************************************************/

/**********************************************************************************************
* Local functions
**********************************************************************************************/

/**********************************************************************************************
* Global functions
**********************************************************************************************/

/*=====================================================================================================================
* Upward trac.:        COMMON/CRC
* Method      :        InvertUint8(uint16_t *dBuf, uint16_t *srcBuf)
* Visibility  :        public
* Description :        Invert one byte data
* Parameters  :        uint8_t *dBuf, uint8_t *srcBuf
* ---------------------------------------------------------------------------------------------------------------------
*     Type      | Name(Direction) |                                      Description
* ---------------------------------------------------------------------------------------------------------------------
* Status_Ref  | Status   | Status reference
* ---------------------------------------------------------------------------------------------------------------------
* Return type :   
* ===================================================================================================================*/
void InvertUint8(uint8_t *dBuf, uint8_t *srcBuf)
{
    int i;
    uint8_t tmp[4];
    tmp[0] = 0;
    for(i=0;i< 8;i++)
    {
        if(0 != (srcBuf[0] & (1 << i)))
            tmp[0]|=1<<(7-i);
        else
        {/*do nothing*/}
    }
    dBuf[0] = tmp[0];

}

/*=====================================================================================================================
* Upward trac.:        COMMON/CRC
* Method      :        InvertUint16(uint16_t *dBuf, uint16_t *srcBuf)
* Visibility  :        public
* Description :        Invert one half word data
* Parameters  :        uint16_t *dBuf, uint16_t *srcBuf
* ---------------------------------------------------------------------------------------------------------------------
*     Type      | Name(Direction) |                                      Description
* ---------------------------------------------------------------------------------------------------------------------
* Status_Ref  | Status   | Status reference
* ---------------------------------------------------------------------------------------------------------------------
* Return type :  void 
* ===================================================================================================================*/
void InvertUint16(uint16_t *dBuf, uint16_t *srcBuf)
{
    int i;
    uint16_t tmp[4];
    tmp[0] = 0;
    for(i=0;i< 16;i++)
    {
        if(0 != (srcBuf[0] & (1 << i)))
            tmp[0]|=1<<(15 - i);
        else
        {/*do nothing*/}
    }
    dBuf[0] = tmp[0];
}

/*=====================================================================================================================
* Upward trac.:        COMMON/CRC
* Method      :        CRC16_CCITT(uint8_t *InputData, uint32_t DataLength)
* Visibility  :        public
* Description :        CRC16_CCITT crc check
* Parameters  :        uint8_t *InputData, uint32_t DataLength
* ---------------------------------------------------------------------------------------------------------------------
*     Type      | Name(Direction) |                                      Description
* ---------------------------------------------------------------------------------------------------------------------
* Status_Ref  | Status   | Status reference
* ---------------------------------------------------------------------------------------------------------------------
* Return type :   uint16_t
* ===================================================================================================================*/
uint16_t CRC16_CCITT(uint8_t *InputData, uint32_t DataLength)
{
    uint16_t wCRCin = 0x0000;
    uint16_t wCPoly = 0x1021;
    uint8_t wChar = 0;

    while(DataLength--)
    {
        wChar = *(InputData++);
        InvertUint8(&wChar,&wChar);
        wCRCin ^= (wChar << 8);
        for(int i = 0;i < 8;i++)
        {
            if(0x8000 & wCRCin)
                wCRCin = (uint16_t)((wCRCin << 1)) ^ wCPoly; /* (uint16_t) Eliminate alarms*/
            else
                wCRCin = wCRCin << 1;
        }
    }
    InvertUint16(&wCRCin,&wCRCin);
    return (wCRCin) ;
}

/*=====================================================================================================================
* Upward trac.:        COMMON/CRC
* Method      :        CRC8(uint8_t *ptr,uint8_t len)
* Visibility  :        public
* Description :        crc8 crc check
* Parameters  :        uint8_t *ptr,uint8_t len
* ---------------------------------------------------------------------------------------------------------------------
*     Type      | Name(Direction) |                                      Description
* ---------------------------------------------------------------------------------------------------------------------
* Status_Ref  | Status   | Status reference
* ---------------------------------------------------------------------------------------------------------------------
* Return type :  uint8_t 
* ===================================================================================================================*/
uint8_t CRC8(uint8_t *ptr,uint8_t len)
{
    uint8_t crc=0;
    uint8_t i;
    
    while(len--)
    {
        crc^=*ptr++;
        for(i=0;i<8;i++)
        {
            if(0x80 & crc)
                crc = (uint8_t)((crc << 1)) ^ 0x07;
            else 
                crc<<=1;
        }
    }
    return crc;
}

/*=====================================================================================================================
* Upward trac.:        COMMON/CRC
* Method      :        CRC8_SAEJ1850(uint8_t *ptr,uint8_t len)
* Visibility  :        public
* Description :        CRC8_SAEJ1850 crc check (0x1D (x8 + x4 + x3 + x2 +1))
* Parameters  :        uint8_t *ptr,uint8_t len
* ---------------------------------------------------------------------------------------------------------------------
*     Type      | Name(Direction) |                                      Description
* ---------------------------------------------------------------------------------------------------------------------
* Status_Ref  | Status   | Status reference
* ---------------------------------------------------------------------------------------------------------------------
* Return type :   uint8_t
* ===================================================================================================================*/
uint8_t CRC8_SAEJ1850(uint8_t *ptr,uint8_t len)
{
    uint8_t i, j;
    uint8_t crc = 0;   

    for(i = 0; i < len; i++)
    {
        crc ^= ptr[i];

        for(j = 0; j < 8; j++)
        {
            if(0x80 & crc)
                crc = (uint8_t)(crc << 1) ^ 0x1D;
            else
                crc <<= 1;
        }
    }

    return crc;
}

#endif /* CRC_COM */

