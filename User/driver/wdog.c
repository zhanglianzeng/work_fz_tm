/******************************************************************************
*  Name: wdog.c
*  Description:
*  Project: Wave2
*  Auther: 
*  MCU: atmel samc21n18a
*  Comment:
******************************************************************************/
#include "./../config.h"
#if (WDOG_DRIVER == 1)
#include "../../Device/samc21n18a.h"
#include "./config/peripheral_clk_config.h"
#include "./config/hpl_wdt_config.h"
#include "wdog.h"
/**********************************************************************************************
* External objects
**********************************************************************************************/

/**********************************************************************************************
* Global variables
**********************************************************************************************/

/**********************************************************************************************
* Constants and macros
**********************************************************************************************/
#define	WDT_PERIOD_8CYCLE         0
#define	WDT_PERIOD_16CYCLE        1
#define	WDT_PERIOD_32CYCLE        2
#define	WDT_PERIOD_64CYCLE        3
#define	WDT_PERIOD_128CYCLE       4
#define	WDT_PERIOD_256CYCLE       5
#define	WDT_PERIOD_512CYCLE       6
#define	WDT_PERIOD_1024CYCLE      7
#define	WDT_PERIOD_2048CYCLE      8
#define	WDT_PERIOD_4096CYCLE      9
#define	WDT_PERIOD_8192CYCLE      10
#define	WDT_PERIOD_16384CYCLE     11

/**********************************************************************************************
* Local types
**********************************************************************************************/

/**********************************************************************************************
* Local variables
**********************************************************************************************/

/**********************************************************************************************
* Local functions
**********************************************************************************************/

/**********************************************************************************************
* Global functions
**********************************************************************************************/

/*=====================================================================================================================
* Upward trac.:        
* Method      :        WDOG_Init
* Visibility  :        public
* Description :        init watchdog module
* Parameters  :        void
* ---------------------------------------------------------------------------------------------------------------------
*     Type      | Name(Direction) |                                      Description
* ---------------------------------------------------------------------------------------------------------------------
* Status_Ref  | Status   | Status reference
* ---------------------------------------------------------------------------------------------------------------------
* Return type :        void
* ===================================================================================================================*/
void WDOG_Init(void)
{
    MCLK->APBAMASK.reg |= 1 << (((uint32_t)WDT & 0x0000ff00) >> 10);
   
    while (WDT->SYNCBUSY.reg);
    WDT->CTRLA.reg &= ~WDT_CTRLA_WEN;
    while (WDT->SYNCBUSY.reg);
    /*set the watchdog time-out period as a number of GCLK_WDT clock cycles*/
    WDT->CONFIG.bit.PER = WDT_PERIOD_512CYCLE;   
    while (WDT->SYNCBUSY.reg);  
    WDT->CTRLA.reg |= WDT_CTRLA_ENABLE; 
}

/*=====================================================================================================================
* Upward trac.:        
* Method      :        WDOG_Feed
* Visibility  :        public
* Description :        clear the Watchdog Timer and restart the watchdog time-out period.
* Parameters  :        void
* ---------------------------------------------------------------------------------------------------------------------
*     Type      | Name(Direction) |                                      Description
* ---------------------------------------------------------------------------------------------------------------------
* Status_Ref  | Status   | Status reference
* ---------------------------------------------------------------------------------------------------------------------
* Return type :        void
* ===================================================================================================================*/
void WDOG_Feed(void)
{
    while (WDT->SYNCBUSY.reg);
    WDT->CLEAR.reg = WDT_CLEAR_CLEAR_KEY; 
}

/*=====================================================================================================================
* Upward trac.:        
* Method      :        WDOG_Enable
* Visibility  :        public
* Description :        enable watchdog module
* Parameters  :        void
* ---------------------------------------------------------------------------------------------------------------------
*     Type      | Name(Direction) |                                      Description
* ---------------------------------------------------------------------------------------------------------------------
* Status_Ref  | Status   | Status reference
* ---------------------------------------------------------------------------------------------------------------------
* Return type :        void
* ===================================================================================================================*/
void WDOG_Enable(void)
{
    while (WDT->SYNCBUSY.reg);  
    WDT->CTRLA.reg |= WDT_CTRLA_ENABLE; 
}

/*=====================================================================================================================
* Upward trac.:        
* Method      :        WDOG_Disable
* Visibility  :        public
* Description :        disable watchdog module
* Parameters  :        void
* ---------------------------------------------------------------------------------------------------------------------
*     Type      | Name(Direction) |                                      Description
* ---------------------------------------------------------------------------------------------------------------------
* Status_Ref  | Status   | Status reference
* ---------------------------------------------------------------------------------------------------------------------
* Return type :        void
* ===================================================================================================================*/
void WDOG_Disable(void)
{
    uint8_t tmp;
	
    while (WDT->SYNCBUSY.reg);
    /* Check of the Watchdog has been locked to be always on, if so, abort */
    tmp = WDT->CTRLA.reg;
    tmp = (tmp & WDT_CTRLA_ALWAYSON) >> WDT_CTRLA_ALWAYSON_Pos;

    if (tmp == 1)
    {
      return;
    }

    while (WDT->SYNCBUSY.reg);  
    WDT->CTRLA.reg &= ~WDT_CTRLA_ENABLE;
}
#endif /*WDG_DRIVER*/

